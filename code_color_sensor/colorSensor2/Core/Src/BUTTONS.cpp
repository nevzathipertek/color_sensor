//program::BUTTONS driver cpp file
// @uthor::Nevzat DURMAZ
//   date::06.06.2020
// update::22.06.2020
//version::03.07
//--------------------------------------------------------------------//
//--------------------------------------------------------------------//
extern "C"{
#include "stm32f1xx_hal.h"
#include "stm32f1xx_hal_gpio.h"
#include "stm32f1xx_hal_rcc.h"
}
#include "BUTTONS.h"
//--------------------------------------------------------------------//
//--------------------------------------------------------------------//
//--------------------------------------------------------------------//
//--------------------------------------------------------------------//
namespace hiper {
//--------------------------------------------------------------------//
//--------------------------------------------------------------------//
//--------------------------------------------------------------------//
//--------------------------------------------------------------------//
void BUTTONS::catchPressedButton(void){

	// select button
	if( __select ){

		if( !_selectfp() ){
			if(++__select_count > shortOsDelay){
				__select = false;
			}
		}
		else __select_count = 0;
	}
	else{

		if(_selectfp()){
			if( ++__select_count > shortOsDelay ) {
				__select = true;
			}
		}
		else __select_count = 0;
	}

	// activate button
	if( __activate ){

		if( !_activatefp() ){
			if(++__activate_count > shortOsDelay){
				__activate = false;
			}
		}
		else __activate_count = 0;
	}
	else{
		if( _activatefp() ){
			if(++__activate_count > shortOsDelay){
				__activate = true;
			}
		}
		else __activate_count = 0;
	}

}
//--------------------------------------------------------------------//
//--------------------------------------------------------------------//
//--------------------------------------------------------------------//
//--------------------------------------------------------------------//
//--------------------------------------------------------------------//
//--------------------------------------------------------------------//
//--------------------------------------------------------------------//
//--------------------------------------------------------------------//
//--------------------------------------------------------------------//
//--------------------------------------------------------------------//
//--------------------------------------------------------------------//
} /* namespace hiper */
//--------------------------------------------------------------------//
//--------------------------------------------------------------------//
